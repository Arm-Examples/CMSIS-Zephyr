## STM32H7B3I-DK_Zephyr/Blank_solution/west.yml
```yaml
manifest:
  remotes:
    - name: zephyrproject
      url-base: https://github.com/zephyrproject-rtos
  projects:
    - name: zephyr
      repo-path: zephyr
      remote: zephyrproject
      revision: v4.1.0
      clone-depth: 1
      import:
        name-allowlist:
          - cmsis
          - cmsis-dsp
          # - picolibc
          # - segger
          - hal_stm32
```
